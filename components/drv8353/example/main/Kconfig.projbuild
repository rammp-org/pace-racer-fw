## components/drv8353/example/main/Kconfig.projbuild
```kconfig
menu "DRV8353 Example Configuration"

config EXAMPLE_SPI_SCLK_GPIO
  int "SPI SCLK GPIO"
  range 0 50
  default 12

config EXAMPLE_SPI_MOSI_GPIO
  int "SPI MOSI GPIO"
  range 0 50
  default 11

config EXAMPLE_SPI_MISO_GPIO
  int "SPI MISO GPIO"
  range 0 50
  default 13

config EXAMPLE_SPI_CS_GPIO
  int "SPI CS GPIO"
  range 0 50
  default 10

config EXAMPLE_SPI_CLOCK_SPEED
  int "SPI Clock Speed (Hz)"
  range 100000 10000000
  default 1000000

config EXAMPLE_ENABLE_GPIO
  int "DRV8353 nSLEEP / enable GPIO (-1 if tied high)"
  range -1 50
  default -1

config EXAMPLE_FAULT_GPIO
  int "DRV8353 nFAULT GPIO (-1 if unused)"
  range -1 50
  default -1

endmenu
```

## components/lm75adp/example/main/Kconfig.projbuild
```kconfig
menu "LM75ADP Example Configuration"

config EXAMPLE_I2C_SDA_GPIO
  int "I2C SDA GPIO"
  range 0 50
  default 21
  default 31 if IDF_TARGET_ESP32P4

config EXAMPLE_I2C_SCL_GPIO
  int "I2C SCL GPIO"
  range 0 50
  default 22
  default 32 if IDF_TARGET_ESP32P4

config EXAMPLE_I2C_CLOCK_SPEED_HZ
  int "I2C Clock Speed"
  range 100000 1000000
  default 400000

config EXAMPLE_I2C_ADDRESS
  hex "LM75ADP I2C Address"
  range 0x48 0x4F
  default 0x48

endmenu
```

## components/pace-racer-board/Kconfig
```kconfig
menu "PACE RACER Configuration"

config PACE_RACER_INTERRUPT_STACK_SIZE
  int "Interrupt stack size"
  default 4096
  help
    Size of the stack used for the interrupt handler. Used by the motor fault
    handler. May also be used by the hall effect sensors if configured.

menu "Ethernet (WIZnet W5500)"

config PACE_RACER_ETH_SPI_CLOCK_MHZ
  int "W5500 SPI clock speed (MHz)"
  default 20
  range 1 33
  help
    SPI clock speed used to communicate with the on-board WIZnet W5500 Ethernet
    breakout on the SPI expansion header. The W5500 supports up to 33.3 MHz; a
    conservative default of 20 MHz is used to tolerate the shared communications
    bus and header wiring. Lower this value if you observe SPI communication
    errors with the Ethernet interface.

config PACE_RACER_ETH_HOSTNAME
  string "Default Ethernet hostname"
  default "pace-racer"
  help
    Default hostname assigned to the Ethernet interface (e.g. advertised over
    DHCP). This is used as the default value of EthernetConfig::hostname and can
    be overridden at runtime.

endmenu

endmenu
```
